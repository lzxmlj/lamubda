/*=============================================================================
** ASAP2 File (generated by Delphi Electronics & Safety)
** ASAP2 Syntax: 1 40
** From IEEE-695 File: Manually Generated for CVVL controller
** IEEE-695 Version: 1.0
** i695x Version: V10.7
** Options: Display Format=10.4, Formatted for INCA 2.0.12
**===========================================================================*/ ASAP2_VERSION 1 40
/begin PROJECT CVVL ""
/begin HEADER "" VERSION "" /end HEADER
/begin MODULE CVVL ""
/begin MOD_PAR "S12Z-CW10.3" VERSION "NA" CUSTOMER_NO "DELPHID" USER "DEG" PHONE_NO "28968866" CPU_TYPE "S12Z" ECU "CVVL ADP"
 /begin MEMORY_SEGMENT Code "External Flash Code Space" CODE FLASH INTERN 0xFE1000 0x0001F000 -1 -1 -1 -1 -1 /end MEMORY_SEGMENT
 /begin MEMORY_SEGMENT Code "External Flash Calibration Space" DATA FLASH INTERN 0xFE0000 0x00000800 -1 -1 -1 -1 -1 /end MEMORY_SEGMENT
 /begin MEMORY_SEGMENT Data "External RAM Calibration Space" DATA RAM EXTERN 0xFE0000 0x00000800 -1 -1 -1 -1 -1 /end MEMORY_SEGMENT
/end MOD_PAR
/begin MOD_COMMON "" BYTE_ORDER LSB_FIRST ALIGNMENT_LONG 4 ALIGNMENT_WORD 2 ALIGNMENT_BYTE 1 /end MOD_COMMON
/begin IF_DATA ASAP1B_CCP /* Specific definition for CCP */
 /begin SOURCE "Commu Event" 103 /* Scaling Unit: 103 = cylinder segment */ 1 /* Rate in Scaling Unit: 1 */ /* Refresh rate = */ /* every cylinder combustion */ DISPLAY_IDENTIFIER DAQ0
  /begin QP_BLOB 0 LENGTH 0x2 CAN_ID_FIXED 0x7F5 RASTER 00 REDUCTION_ALLOWED FIRST_PID 0x00 /end QP_BLOB
 /end SOURCE
 /begin SOURCE "7.82ms" 1 782 /* Rate in Scaling Unit: 782 */ /* Refresh rate = 782 * 10 us = 7.82ms */ DISPLAY_IDENTIFIER DAQ1
  /begin QP_BLOB 1 LENGTH 0x2 CAN_ID_FIXED 0x7F6 RASTER 10 REDUCTION_ALLOWED FIRST_PID 0x2 /end QP_BLOB
 /end SOURCE
 /begin SOURCE "15.6ms" 1 1562 /* Rate in Scaling Unit: 1562 */ /* Refresh rate = 1562 * 10us = 15.62ms */ DISPLAY_IDENTIFIER DAQ2
  /begin QP_BLOB 2 LENGTH 0x4 CAN_ID_FIXED 0x7F7 RASTER 11 REDUCTION_ALLOWED FIRST_PID 0x4 /end QP_BLOB
 /end SOURCE
 /begin SOURCE "8ms" 3 /* Scaling Unit: 3 = 1 ms */ 8 /* Rate in Scaling Unit: 8 */ /* Refresh rate = 1 * 8 ms = 8ms */ DISPLAY_IDENTIFIER DAQ3
  /begin QP_BLOB 3 LENGTH 0x4 CAN_ID_FIXED 0x7F8 RASTER 25 REDUCTION_ALLOWED FIRST_PID 0x8 /end QP_BLOB
 /end SOURCE
 /begin RASTER "Commutation Event Trigger" "Com" 0 103 /* Scaling Unit: 103 = cylinder segment */ 1 /* Rate in Scaling Unit: 1 */ /* Refresh rate = */ /* every cylinder combustion */ /end RASTER
 /begin RASTER "3.91ms Trigger" "3.91" 10 1 391 /* Rate in Scaling Unit: 391 */ /* Refresh rate = 781 * 10 us = 7.81ms */ /end RASTER
 /begin RASTER "15.62ms Trigger" "15.62" 11 1 1562 /* Rate in Scaling Unit: 1562 */ /* Refresh rate = 1562 * 10us = 15.62ms */ /end RASTER
 /begin RASTER "8ms Trigger" "125" 25 3 /* Scaling Unit: 3 = 1 ms */ 8 /* Rate in Scaling Unit: 125 */ /* Refresh rate = 1 * 8 ms = 8ms */ /end RASTER
 /begin SEED_KEY "" "" "" /end SEED_KEY
 /begin TP_BLOB 0x0201 /* CCP Version, High Byte: Version
Low Byte : subversion (dec.) */ 0x0202 /* Blob-Version, High Byte: Version
Low Byte : subversion (dec.) */ 0x7F0 /* CAN-Message ID for 'Transmitting to ECU (CRM)'
Bit31 = 1: extended Identifier
Bit31 = 0: standard Identifier */ 0x7F4 /* CAN-Message ID for 'Receiving from ECU (DTM)'
Bit31 = 1: extended Identifier
Bit31 = 0: standard Identifier */ 0x0000 /* Logical CCP-Address of the (station address) */ 1 /* Byte order of Multiple-byte-items
1 = high Byte first, 2 = low byte first */ BAUDRATE 500000 SAMPLE_POINT 75 SAMPLE_RATE 1 BTL_CYCLES 16 SJW 3 SYNC_EDGE 0 DAQ_MODE 1 /* 1 = one DAQ per cycle */ CONSISTENCY 1 /* 1 = ODT consistant */ ADDRESS_EXTENSION 0 /* 0 = 1 extension per DAQ (not supported) */ RESUME_SUPPORTED /* necessary for ResumeBit support */ /* STORE_SUPPORTED */ /* Not supported */
  /begin CHECKSUM_PARAM 0x8002 /* checksum calculation procedure
standard types not yet defined,
if greater of equal 1000 : manufacturer specific */ 0x3FFF /* Maximum block length used by an ASAP1a-CCP
command, for checksum calculation procedure */ CHECKSUM_CALCULATION ACTIVE_PAGE /end CHECKSUM_PARAM
  /begin DEFINED_PAGES 1 "Working page" 0 0x20000000 0x4000 /* To maintian one A2L file the start address of working page is defined as andorra configruation */ RAM /* this will be converted according to the actual type of instrumentation. */ RAM_INIT_BY_ECU DEFAULT /end DEFINED_PAGES
  /begin DEFINED_PAGES 2 "Reference page" 0 0x20000000 0x4000 FLASH DEFAULT /end DEFINED_PAGES
  OPTIONAL_CMD 0x0C /* SET_S_STATUS */ OPTIONAL_CMD 0x0D /* GET_S_STATUS */ OPTIONAL_CMD 0x0E /* Build Checksum */ OPTIONAL_CMD 0x11 /* SelectCal page */ OPTIONAL_CMD 0x19 /* Move */ /end TP_BLOB
/end IF_DATA
/begin CHARACTERISTIC KfMOTOR_RPM_RampMulti "Ramp step per loop for RPM calc filter, Units: multiplier" VALUE 0xFE0000 Delphi_D_Scalar_UW 0 Filter_Coefficient_W 0.0 0.99998474121 /end CHARACTERISTIC
/begin CHARACTERISTIC KaPMF_DutyCycle_RampMulti.data "duty cycle ramp rate" CURVE 0xFE0008 Delphi_D_2D_Array_UW 0 Filter_Coefficient_W 0.0 0.99998474121
 /begin AXIS_DESCR FIX_AXIS NO_INPUT_QUANTITY N_EQUALS_E_Comp 6 60 3000 /begin FIX_AXIS_PAR_LIST 60 200 500 1000 2000 3000 /end FIX_AXIS_PAR_LIST /end AXIS_DESCR
/end CHARACTERISTIC
/begin CHARACTERISTIC KtPMF_PWMDutyCycle.x_length "DC vs delta steps, Units: x length" VALUE 0xFE0014 Delphi_D_Scalar_UW 0 W_x_length 0.0 65535.0 READ_ONLY /end CHARACTERISTIC
/begin CHARACTERISTIC KtPMF_PWMDutyCycle.y_length "DC vs RPM, Units: y length" VALUE 0xFE0016 Delphi_D_Scalar_UW 0 W_y_length 0.0 65535.0 READ_ONLY /end CHARACTERISTIC
/begin CHARACTERISTIC KtPMF_PWMDutyCycle.data "Alternator load vs delta steps and RPM " MAP 0xFE0018 Delphi_D_3D_Array_UW 0 t_percent_ 0.0 0.99996948
 /begin AXIS_DESCR FIX_AXIS NO_INPUT_QUANTITY N_EQUALS_E_Comp 6 60 3000 /begin FIX_AXIS_PAR_LIST 60 200 500 1000 2000 3000 /end FIX_AXIS_PAR_LIST /end AXIS_DESCR
 /begin AXIS_DESCR FIX_AXIS NO_INPUT_QUANTITY N_EQUALS_E_Comp 12 0 140 /begin FIX_AXIS_PAR_LIST 0 1 2 4 7 12 18 25 40 60 90 140 /end FIX_AXIS_PAR_LIST /end AXIS_DESCR
/end CHARACTERISTIC
/begin CHARACTERISTIC KbINST_EnableCALDataBackup " Sets to initiate one time CAL data backup" VALUE 0xFE00A8 Delphi_D_Scalar_UB 0 size2_0to1 0.0 1.0 /end CHARACTERISTIC
/begin FUNCTION CALs "No Long Identifier"
 /begin REF_CHARACTERISTIC KfMOTOR_RPM_RampMulti KaPMF_DutyCycle_RampMulti.data KtPMF_PWMDutyCycle.x_length KtPMF_PWMDutyCycle.y_length KtPMF_PWMDutyCycle.data /end REF_CHARACTERISTIC
/end FUNCTION
/begin COMPU_METHOD W_x_length "" RAT_FUNC "%5.0" "x length" COEFFS 0.0 1.0 0.000000 0.0 0.0 1.000000000000 /end COMPU_METHOD
/begin COMPU_METHOD W_y_length "" RAT_FUNC "%5.0" "y length" COEFFS 0.0 1.0 0.000000 0.0 0.0 1.000000000000 /end COMPU_METHOD
/begin COMPU_METHOD Filter_Coefficient_W "" RAT_FUNC "%7.6" "multiplier" COEFFS 0.0 1.0 0.000000 0.0 0.0 0.000015258789 /end COMPU_METHOD
/begin COMPU_METHOD N_EQUALS_E_Comp "Default N=E compu method" RAT_FUNC "%10.4" "" COEFFS 0.0 1.0 0.0 0.0 0.0 1.0 /end COMPU_METHOD
/begin COMPU_METHOD t_percent_ "" RAT_FUNC "%8.5" "pct" COEFFS 0.0 1.0 0.000000 0.0 0.0 0.00003051757812 /end COMPU_METHOD
/begin COMPU_METHOD size2_0to1 "" RAT_FUNC "%1.0" "boolean" COEFFS 0.0 1.0 0.000000 0.0 0.0 1.000000000000 /end COMPU_METHOD
/begin RECORD_LAYOUT Delphi_D_Scalar_UW FNC_VALUES 1 UWORD COLUMN_DIR DIRECT /end RECORD_LAYOUT
/begin RECORD_LAYOUT Delphi_D_2D_Array_UW FNC_VALUES 1 UWORD COLUMN_DIR DIRECT /end RECORD_LAYOUT
/begin RECORD_LAYOUT Delphi_D_3D_Array_UW FNC_VALUES 1 UWORD COLUMN_DIR DIRECT /end RECORD_LAYOUT
/begin RECORD_LAYOUT Delphi_D_Scalar_UB FNC_VALUES 1 UBYTE COLUMN_DIR DIRECT /end RECORD_LAYOUT
/begin MEASUREMENT abc "1ms counter" UWORD VcOSKN_LoopCountMain_DS_Scaling 0 0.000000 0.000000 65535.00 ECU_ADDRESS 0x20000022 DISPLAY_IDENTIFIER ABC /end MEASUREMENT
/begin MEASUREMENT InputVoltageMv1 "1ms counter" UWORD VcOSKN_LoopCountMain_DS_Scaling 0 0.000000 0.000000 65535.00 ECU_ADDRESS 0x20000026 /end MEASUREMENT
/begin MEASUREMENT OSTICK "1ms counter" UBYTE VcOSKN_LoopCountMain_DS_Scaling 0 0.000000 0.000000 255.000000 ECU_ADDRESS 0x1BEF DISPLAY_IDENTIFIER VcOSKN_LoopCountMain /end MEASUREMENT
/begin MEASUREMENT RTICOUNT "1ms RTI counter" ULONG ScHWIO_RTI_Int_Counter_DS_Scaling 0 0.000000 0.000000 4294967.295 ECU_ADDRESS 0x198A DISPLAY_IDENTIFIER ScHWIO_RTI_Int_Counter /end MEASUREMENT
/begin COMPU_METHOD ScHWIO_RTI_Int_Counter_DS_Scaling "Ax + B" RAT_FUNC "%4.2" "" COEFFS 0.0 1.0 0.000000 0.0 0.0 0.001 /end COMPU_METHOD
/begin COMPU_METHOD VcOSKN_LoopCountMain_DS_Scaling "Ax + B" RAT_FUNC "%4.0" "counts" COEFFS 0.0 1.0 0.000000 0.0 0.0 1.000000000000 /end COMPU_METHOD
/end MODULE
/end PROJECT
