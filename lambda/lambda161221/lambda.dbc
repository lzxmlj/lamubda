VERSION ""

NS_ :

BS_:

BU_:
BO_ 1947 message1: 8 Vector__XXX
 SG_ spi_l : 23|16@0+ (1,0) [0|65535] "" Vector__XXX
 SG_ spi_h : 7|16@0+ (1,0) [0|65535] "" Vector__XXX

BO_ 1946 message1: 8 Vector__XXX
 SG_ UR : 32|32@1- (1,0) [-3.4E+038|3.4E+038] "V" Vector__XXX
 SG_ UA : 0|32@1- (1,0) [-3.4E+038|3.4E+038] "v" Vector__XXX

BO_ 1945 message1: 8 Vector__XXX
 SG_ RI : 0|32@1- (1,0) [-3.4E+038|3.4E+038] "0mg" Vector__XXX

BO_ 1944 message1: 8 Vector__XXX
 SG_ pwm : 32|32@1- (1,0) [-3.4E+038|3.4E+038] "%" Vector__XXX
 SG_ air_faul : 0|32@1- (1,0) [-3.4E+038|3.4E+038] "lambda" Vector__XXX

SIG_VALTYPE_ 1 channel01 : 1;
SIG_VALTYPE_ 2 channel02 : 1;
